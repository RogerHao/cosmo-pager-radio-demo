## firmware/main/Kconfig.projbuild
```kconfig
menu "HID Example Configuration"
    config DEVICE_NUMBER
        int "Device Number (01-99)"
        range 0 99
        default 0
        help
            Unique device number for BLE name (cosmo-XX).
            Set 1-99 to assign a number, 0 means unassigned.
            Example: 1 -> "cosmo-01", 12 -> "cosmo-12"

    config EXAMPLE_SSP_ENABLED
        bool "Secure Simple Pairing"
        depends on BT_CLASSIC_ENABLED
        default y
        help
            This enables the Secure Simple Pairing. If disable this option,
            Bluedroid will only support Legacy Pairing

    choice EXAMPLE_HID_DEVICE_ROLE
        prompt "HID Device Role"
        depends on BT_NIMBLE_ENABLED
        default EXAMPLE_KBD_ENABLE
        help
            Three Supported Roles for Device
            - Media Device
            - Keyboard
            - Mouse

        config EXAMPLE_MEDIA_ENABLE
            select BT_NIMBLE_HID_SERVICE
            bool "Enable Media Device"

        config EXAMPLE_KBD_ENABLE
            select BT_NIMBLE_HID_SERVICE
            bool "Enable Keyboard Device"

        config EXAMPLE_MOUSE_ENABLE
            select BT_NIMBLE_HID_SERVICE
            bool "Enable Mouse Device"
    endchoice

    config EXAMPLE_HID_DEVICE_ROLE
        int
        default 1 if EXAMPLE_MEDIA_ENABLE
        default 2 if EXAMPLE_KBD_ENABLE
        default 3 if EXAMPLE_MOUSE_ENABLE
endmenu
```

## firmware/sdkconfig.defaults
```kconfig
# =============================================================================
# Cosmo Pager Radio - ESP32 BLE HID Keyboard Configuration
# Target: Seeed Studio XIAO ESP32S3
# =============================================================================

# -----------------------------------------------------------------------------
# Bluetooth Configuration - NimBLE Only (No Classic BT)
# -----------------------------------------------------------------------------
# Enable Bluetooth
CONFIG_BT_ENABLED=y

# Use NimBLE stack (lighter than Bluedroid, ~30KB smaller)
# Must explicitly disable Bluedroid since it's the default in choice BT_HOST
CONFIG_BT_BLUEDROID_ENABLED=n
CONFIG_BT_NIMBLE_ENABLED=y

# NimBLE HID Service
CONFIG_BT_NIMBLE_HID_SERVICE=y

# Device name (will appear when pairing)
CONFIG_BT_NIMBLE_SVC_GAP_DEVICE_NAME="cosmo-radio-input"

# Security - enable bonding for persistent pairing
CONFIG_BT_NIMBLE_SM_LEGACY=y
CONFIG_BT_NIMBLE_SM_SC=y

# Reduce NimBLE memory usage
CONFIG_BT_NIMBLE_MAX_CONNECTIONS=1
CONFIG_BT_NIMBLE_MAX_BONDS=3
CONFIG_BT_NIMBLE_MAX_CCCDS=8
CONFIG_BT_NIMBLE_ROLE_CENTRAL=n
CONFIG_BT_NIMBLE_ROLE_OBSERVER=n

# -----------------------------------------------------------------------------
# HID Device Configuration
# -----------------------------------------------------------------------------
# Set device role to Keyboard (from Kconfig.projbuild)
CONFIG_EXAMPLE_KBD_ENABLE=y

# -----------------------------------------------------------------------------
# Flash & Partition
# -----------------------------------------------------------------------------
# Use large single app partition (more space for code)
CONFIG_PARTITION_TABLE_SINGLE_APP_LARGE=y

# Flash size for XIAO ESP32S3 (8MB)
CONFIG_ESPTOOLPY_FLASHSIZE_8MB=y

# -----------------------------------------------------------------------------
# Power Management
# -----------------------------------------------------------------------------
# Disable tickless idle to prevent BLE disconnection issues
# With optimized connection parameters (~200µA), 3000mAh battery lasts months
CONFIG_PM_ENABLE=y
CONFIG_FREERTOS_USE_TICKLESS_IDLE=n

# -----------------------------------------------------------------------------
# Logging (reduce for production)
# -----------------------------------------------------------------------------
# CONFIG_LOG_DEFAULT_LEVEL_INFO=y
# CONFIG_LOG_MAXIMUM_LEVEL_INFO=y

# -----------------------------------------------------------------------------
# Compiler Optimization
# -----------------------------------------------------------------------------
# Optimize for size (saves flash, slightly slower)
# CONFIG_COMPILER_OPTIMIZATION_SIZE=y
```

## firmware/sdkconfig.defaults.esp32s3
```kconfig
# ESP32-S3 specific defaults
# Force NimBLE instead of Bluedroid
CONFIG_BT_BLUEDROID_ENABLED=n
CONFIG_BT_NIMBLE_ENABLED=y
CONFIG_BT_CONTROLLER_ONLY=n

# HID Device Role = Keyboard
CONFIG_EXAMPLE_MEDIA_ENABLE=n
CONFIG_EXAMPLE_KBD_ENABLE=y
CONFIG_EXAMPLE_MOUSE_ENABLE=n
```

## sdkconfig.defaults
```kconfig
# Cosmo Radio V4 — ESP32-S3 DevKitC N16R8
# 16 MB QIO flash + 8 MB Octal PSRAM
#
# This file was hand-edited (not via `idf.py save-defconfig`) so the comments
# survive regeneration. Keep it minimal: only options that diverge from the
# ESP-IDF defaults belong here.

# --- TinyUSB HID ---
CONFIG_TINYUSB_HID_COUNT=1

# --- Flash (N16R8 = 16 MB QIO @ 80 MHz) ---
CONFIG_ESPTOOLPY_FLASHSIZE_16MB=y
CONFIG_ESPTOOLPY_FLASHMODE_QIO=y
CONFIG_ESPTOOLPY_FLASHFREQ_80M=y

# --- PSRAM (N16R8 = 8 MB Octal @ 80 MHz, internal pins GPIO26-37) ---
# We don't actively allocate to PSRAM today, but enabling it (a) silences the
# bootloader's flash-size mismatch warning and (b) makes the heap automatically
# fall back to PSRAM if a future feature (audio buffers, image cache) needs it.
CONFIG_SPIRAM=y
CONFIG_SPIRAM_MODE_OCT=y
CONFIG_SPIRAM_SPEED_80M=y

# --- Partition Table ---
# 3 MB factory app, no OTA. Plenty for the HID + NFC firmware (~600 KB today).
CONFIG_PARTITION_TABLE_SINGLE_APP_LARGE=y
```
